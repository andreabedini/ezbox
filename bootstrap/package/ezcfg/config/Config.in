## bootstrap/package/ezcfg/config/Config.in
```kconfig
#
# For a description of the syntax of this configuration file,
# see scripts/kbuild/config-language.txt.
#

menu "ezcfg Settings"

choice
	prompt "Target Distro"
	default EZCFG_EZBOX_DISTRO_KUAFU
	help
	  Please select your target ezbox distro.

config EZCFG_EZBOX_DISTRO_KUAFU
	bool "Kuafu"
	default y
	help
	  ezbox Kuafu distro is for Linux embedded-system study purpose.

config EZCFG_EZBOX_DISTRO_HUANGDI
	bool "Huangdi"
	default n
	help
	  ezbox Huangdi distro is an all-in-one system.

config EZCFG_EZBOX_DISTRO_JINGWEI
	bool "Jingwei"
	default n
	help
	  ezbox Jingwei distro is for VoIP service gateway.

config EZCFG_EZBOX_DISTRO_QIAOCHUI
	bool "Qiaochui"
	default n
	help
	  ezbox Qiaochui distro is for CNC machine control.

config EZCFG_EZBOX_DISTRO_LILOU
	bool "Lilou"
	default n
	help
	  ezbox LiLou distro is for intelligent home security system.

endchoice

endmenu

comment "Utilities"

source "package/ezcfg/config/igrs/Config.in"
```
